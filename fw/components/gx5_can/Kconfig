## fw/components/gx5_can/Kconfig
```kconfig
menu "GX5s CAN bus"
    config GX5_CAN
        bool "CAN bus (OBD-II / J1939) and vehicle profile"
        default y
        help
            As shipped it listens while ignition is on. The vehicle profile
            (requests, decoded signals, a request list per state, the ignition
            rule) is set at runtime over MQTT or USB and kept in NVS; see
            fw/README.md. The CAN driver blocks light sleep while it runs.
    config GX5_CAN_BITRATE
        int "Default CAN bitrate (bit/s)"
        depends on GX5_CAN
        default 500000
endmenu
```

## fw/components/gx5_core/Kconfig
```kconfig
menu "GX5s board pins"
    config GX5_MODEM_TX_GPIO
        int "ESP32 UART TX to the modem"
        default 23
    config GX5_MODEM_RX_GPIO
        int "ESP32 UART RX from the modem"
        default 22
    config GX5_CAN_EN_GPIO
        int "CAN transceiver RS/enable, low = active (-1 = not fitted)"
        default 0
        help
            GPIO0 is also the boot-mode strap; it is only driven after boot.
    config GX5_EXT_PWR_GPIO
        int "Harness feed enable EXT-PWR: board runs from the vehicle supply (-1 = not fitted)"
        default 13
    config GX5_EXT_PWR_ACTIVE_HIGH
        bool "EXT-PWR is active high"
        default n
        help
            Enables the 36V->5V buck (TPS5430, via Q2). Off, the board runs
            from its LiPo (or USB). Measured on the bench: LOW
            draws from the harness, HIGH does not.
endmenu
```

## fw/components/gx5_ext/Kconfig
```kconfig
menu "GX5s external UART (harness SAT-TX / SAT-RX)"
    config GX5_EXT_UART
        bool "Enable the external UART"
        default y
    config GX5_EXT_BAUD
        int "Baud rate"
        depends on GX5_EXT_UART
        default 9600
    config GX5_EXT_TX_GPIO
        int "ESP32 TX pin (SAT-TX)"
        depends on GX5_EXT_UART
        default 19
    config GX5_EXT_RX_GPIO
        int "ESP32 RX pin (SAT-RX)"
        depends on GX5_EXT_UART
        default 21
endmenu
```

## fw/components/gx5_io/Kconfig
```kconfig
menu "GX5s motion wake (MPU-6050)"
    config GX5_MOTION_WAKE
        bool "MPU-6050 wakes the device from SLEEP on motion"
        default y
        help
            The IMU stays powered during SLEEP (from the LiPo when one is fitted).
            APS-INT is the GPIO12 boot strap: if the chip is reset (not woken)
            while a motion interrupt is latched, a module without the flash
            voltage eFuse set may fail to boot until power is cycled. Fix once
            with: espefuse.py set_flash_voltage 3.3V
    config GX5_MOTION_THRESHOLD
        int "Motion threshold (MPU-6050 MOT_THR, about 2 mg per step)"
        depends on GX5_MOTION_WAKE
        range 1 255
        default 40
    config GX5_HARSH_ACCEL_MG
        int "Harsh acceleration threshold (mg)"
        default 300
    config GX5_HARSH_BRAKE_MG
        int "Harsh braking threshold (mg)"
        default 400
    config GX5_HARSH_TURN_MG
        int "Harsh cornering threshold (mg)"
        default 400
        help
            Driving events are detected while ignition is on, from the gyro and
            accelerometer together (motion.h). An event must last 0.3 s.
endmenu
```

## fw/components/gx5_modem/Kconfig
```kconfig
menu "GX5s modem and MQTT"

    menu "Bootstrap (provisioning) broker"
        comment "Anonymous, client id = MAC. Used until the backend provisions the real broker"
        config GX5_MQTT_HOST
            string "Bootstrap broker host (name or IP)"
            default "mqtt.reactiot.com.au"
        config GX5_MQTT_PORT
            int "Broker port"
            default 1883
        config GX5_MQTT_TLS
            bool "Bootstrap broker uses TLS (handled by the modem)"
            default n
            help
                Off (port 1883), the provisioning message travels unencrypted,
                including the production broker's username and password.
    endmenu

    config GX5_MQTT_KEEPALIVE_S
        int "Keepalive (s)"
        default 120
    config GX5_MQTT_TLS_SECLEVEL
        int "TLS seclevel, all brokers: 0 none (INSECURE), 1 verify server, 2 mutual"
        range 0 2
        default 1
    config GX5_MQTT_TLS_CACERT
        string "CA cert file on the modem filesystem (upload with AT+QFUPL)"
        default "cacert.pem"

    config GX5_OTA_URL
        string "Firmware server for OTA: <url>/fw/<hardware id>-<version>.bin"
        default "http://ota.reactiot.com.au"
        help
            Fetched by the modem on {"cmd":"ota","version":"x"}. Over plain http
            the image is not authenticated: whoever can answer for this host
            can install firmware.

    config GX5_PROVISION_AFTER_FAILS
        int "Fall back to the bootstrap broker after this many failed connects"
        default 5
        range 1 200
        help
            Counts consecutive failures to reach the provisioned broker while the
            cellular network is up. After one bootstrap attempt the provisioned
            broker gets another round.

    config GX5_APN
        string "Cellular APN (empty = keep the modem's stored APN)"
        default ""

    config GX5_GNSS
        bool "Read the modem's GNSS fix (lat/lon/kmh) for telemetry, live and offline"
        default y
endmenu
```

## fw/components/gx5_store/Kconfig
```kconfig
menu "GX5s offline store (SD NAND)"
    config GX5_STORE
        bool "Queue telemetry on the SD NAND while offline"
        default y
    config GX5_STORE_MAX_KB
        int "Offline queue size limit (KB)"
        depends on GX5_STORE
        default 1024
endmenu
```

## fw/main/Kconfig.projbuild
```kconfig
menu "GX5s application"

    config GX5_MANUFACTURER
        string "Manufacturer (startup banner)"
        default "React IoT"
    config GX5_WEBSITE
        string "Manufacturer website (startup banner)"
        default "reactiot.com.au"
    config GX5_REPO
        string "Source repository (startup banner)"
        default "github.com/react-iot/gx5s"
    config GX5_PRODUCT_NAME
        string "Product name (startup banner)"
        default "GX5s Logger"
    config GX5_PRODUCT_ID
        string "Hardware id (startup banner)"
        default "riot-gx5s"

    menu "Supply protection"
        config GX5_VCC_CUTOFF_MV
            int "Enter PROTECT below this supply voltage (mV)"
            default 11000
            help
                11 V is what the earlier GX5sV2 firmware used. The board reads up to
                ~0.6 V below the supply while the LiPo charges, so a cutoff near the
                resting voltage (12 V lead-acid: 12.0 V is ~50 %, 11.8 V ~30 %) trips
                on a healthy battery. Use ~22000 for 24 V systems.
        config GX5_VCC_HYST_MV
            int "Leave PROTECT only above cutoff + this (mV)"
            default 400
        config GX5_VCC_ABSENT_MV
            int "Below this there is no harness supply (USB/LiPo): no protection (mV)"
            default 6000
            help
                USB bench power reads ~4.4 V here, so this must sit above that.
                A 12 V battery below this is not protected.
        config GX5_BAT_MIN_MV
            int "Keep the harness feed on while asleep when the LiPo is below (mV)"
            default 3500
            help
                Asleep (SLEEP and PROTECT) the board runs from its LiPo and
                draws nothing from the vehicle. Below this (or with no LiPo
                fitted, which reads 0) the harness feed stays on (~7 mA) so the
                board keeps running; the LiPo is recharged when next awake
                with a healthy supply.
        config GX5_VCC_VBE_MV
            int "VCC sense calibration: Q4 base-emitter voltage (mV)"
            default 605
            help
                The supply is sensed through a divider loaded by transistor Q4,
                so the reading depends on its Vbe. Measure the supply with a
                meter: for every 21 mV the firmware reads high, raise this by
                1 mV. 605 was measured on one board at room temperature.
                Vbe falls about 2 mV per degC, so expect the reading to move
                roughly -40 mV per degC (not compensated).
        config GX5_PROTECT_RECHECK_S
            int "Re-measure the supply every (s) while in PROTECT"
            default 1800
        config GX5_VCC_WAKE_MV
            int "Wake from sleep when the supply rises this much (mV, 0 = never)"
            default 800
            help
                For vehicle profiles with "wake":"vcc" (no ignition wire, and an
                OBD-II port that carries no traffic): the alternator lifting the supply is
                the sign of an engine start. The ULP coprocessor samples the
                supply four times a second and wakes the device when it stays this
                far above the lowest level seen during the sleep.
    endmenu

    menu "Timing"
        config GX5_HEARTBEAT_S
            int "Ignition off: wake and report every (s)"
            default 3600
        config GX5_HIBERNATE
            bool "Ignition off: modem radio off while asleep (hibernate)"
            default n
            help
                Off (standby): the modem sleeps but stays registered, so an
                SMS or a queued command can wake the device, and a wake
                reconnects in seconds.
                On (hibernate): the modem radio is switched off (AT+CFUN=0)
                for every ignition-off sleep. The device cannot be reached
                until it wakes by itself (ignition, motion or the heartbeat
                timer), and every wake pays a network registration. The
                BG96 Mini PCIe card cannot be powered down: it restarts by
                itself (docs/adr/0001-base-firmware.md, decision 5).
        config GX5_TELEMETRY_S
            int "Ignition on: publish telemetry every (s)"
            default 60
        config GX5_LINGER_S
            int "Ignition off: stay connected this long before sleeping (s)"
            default 30
        config GX5_CONNECT_TIMEOUT_S
            int "Ignition off: give up connecting and sleep after (s)"
            default 180
    endmenu

    config GX5_LIGHT_SLEEP
        bool "Automatic light sleep while awake (needs modem RI wired to GSM-INT)"
        default y

endmenu
```
